

//================================================================//
//   _____                                                        //
//  / ____|                                                       //
// | |     ___  _ __ ___  _ __   __ _  __ _ _ __   ___  _ __      //
// | |    / _ \| '_ ` _ \| '_ \ / _` |/ _` | '_ \ / _ \| '_ \     //
// | |___| (_) | | | | | | |_) | (_| | (_| | | | | (_) | | | |    //
//  \_____\___/|_| |_| |_| .__/ \__,_|\__, |_| |_|\___/|_| |_|    //
//                       | |           __/ |                      //
//                       |_|          |___/                       //
//================================================================//
//                      By @fredolebricolo                        //
//                                                                //
// Program version : BETA 0.5                                     //
//                                                                //
//    Compagnon body : ESP32-C3 V0.1                              //
//    Oled : SSD1106 /SSD 1315                                    //
//    Micropross : ESP332-C3                                      //
//    Programmer : AVR isp (arduino nano)                         //
//                                                                //
//================================================================//


#include <EEPROM.h>
#include <Wire.h>
#include <ESP32Time.h>
#include <Adafruit_GFX.h>
#include <Adafruit_SSD1306.h>
#include <Adafruit_BMP280.h>
#include <SHT3x.h>
#include <driver/adc.h>

#define LED 5
#define PWR 2
#define BP1 0
#define BP2 1
#define BP3 3
#define PIN_BUZZER 10
#define nbr_item_menu 7
#define MesBat 4
#define MesBatEn 7
#define charge 6

#define SCREEN_WIDTH 128 // OLED display width, in pixels
#define SCREEN_HEIGHT 64 // OLED display height, in pixels

#define I2C_SDA 18
#define I2C_SCL 19

#define EEPROM_SIZE 12

bool b1,b2,b3;

ESP32Time rtc;
Adafruit_SSD1306 display(SCREEN_WIDTH, SCREEN_HEIGHT, &Wire, -1);

Adafruit_BMP280 bmp; // use I2C interface

SHT3x STH30;
const unsigned char oeuil[] PROGMEM = { // 33 * 32
  0x00, 0x0F, 0xF8, 0x00, 0x00, 0x00, 0x7F, 0xFF, 0x00, 0x00, 0x00, 0xFF,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 0x00,
  0xF8, 0x00, 0xFF, 0xFF, 0x80, 0xFC, 0x01, 0xFF, 0xFF, 0x80, 0xFE, 0x03,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 0x00,
  0x1F, 0xFF, 0xFF, 0xFE, 0x00, 0x0F, 0xFF, 0xFF, 0xFC, 0x00, 0x07, 0xFF,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 0x00
};

const unsigned char oeuil2[] PROGMEM = { // 33 * 20
  0x60, 0x00, 0x00, 0x03, 0x00, 0xF0, 0x00, 0x00, 0x03, 0x80, 0xF0, 0x00,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 0x80,
  0x78, 0x00, 0x00, 0x0F, 0x80, 0x7C, 0x00, 0x00, 0x1F, 0x00, 0x3C, 0x00,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 0x00,
  0x03, 0xFF, 0xFF, 0xE0, 0x00, 0x01, 0xFF, 0xFF, 0x80, 0x00, 0x00, 0x7F, 0xFF, 0x00, 0x00, 0x00, 0x1F, 0xF8, 0x00, 0x00
};

const unsigned char oeuil3[] PROGMEM = { //32 * 12
  0x0F, 0xFF, 0xFF, 0xFF, 0xE0, 0x7F, 0xFF, 0xFF, 0xFF, 0xF0, 0xFF, 0xFF, 0xFF, 0xFF, 0xF0, 0xFF, 0xFF, 0xFF, 0x87, 0xF0,
  0x7F, 0xFF, 0xFF, 0x03, 0xF0, 0x00, 0x01, 0xFF, 0x03, 0xC0, 0x00, 0x00, 0xFF, 0x03, 0x80, 0x00, 0x00, 0xFF, 0x03, 0x80,
  0x00, 0x00, 0x7F, 0x87, 0x00, 0x00, 0x00, 0x3F, 0xFE, 0x00, 0x00, 0x00, 0x1F, 0xFC, 0x00, 0x00, 0x00, 0x0F, 0xF8, 0x00
};
const unsigned char oeuil4g[] PROGMEM = { // 27 * 22
  0x70, 0x00, 0x00, 0x00, 0x7C, 0x00, 0x00, 0x00, 0xFF, 0x00, 0x00, 0x00,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 0x00,
  0x00, 0x07, 0xFF, 0xC0, 0x00, 0x07, 0xFF, 0xE0, 0x00, 0x3F, 0xFF, 0xE0,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 0x00,
  0xFE, 0x00, 0x00, 0x00, 0xF0, 0x00, 0x00, 0x00
};

const unsigned char oeuil4d[] PROGMEM = { // 27 * 22
  0x00, 0x00, 0x01, 0xC0, 0x00, 0x00, 0x07, 0xC0, 0x00, 0x00, 0x1F, 0xE0,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 0x00,
  0x7F, 0xFC, 0x00, 0x00, 0xFF, 0xFC, 0x00, 0x00, 0xFF, 0xFF, 0x80, 0x00,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 0xC0,
  0x00, 0x00, 0x0F, 0xE0, 0x00, 0x00, 0x01, 0xE0
};

const unsigned char bouche[] PROGMEM = { //37 * 15
  0x60, 0x00, 0x00, 0x00, 0x30, 0xF0, 0x00, 0x00, 0x00, 0x78, 0xF0, 0x00, 0x00, 0x00, 0xF8, 0xF0, 0x00, 0x00, 0x00, 0xF8, 0xF8, 0x00, 0x70, 0x00, 0xF8,
  0xF8, 0x00, 0xF8, 0x00, 0xF8, 0xF8, 0x00, 0xF8, 0x00, 0xF0, 0x7C, 0x01, 0xF8, 0x01, 0xF0, 0x7C, 0x01, 0xFE, 0x03, 0xE0, 0x3F, 0x07, 0xFF, 0x07, 0xE0,
  0x1F, 0xFF, 0xFF, 0xFF, 0xE0, 0x0F, 0xFF, 0x8F, 0xFF, 0xC0, 0x0F, 0xFF, 0x8F, 0xFF, 0x80, 0x03, 0xFC, 0x03, 0xFE, 0x00, 0x00, 0xF8, 0x01, 0xFC, 0x00
};

const unsigned char bouche2[] PROGMEM = { //32 * 19
  0x00, 0x00, 0x00, 0x00, 0x00, 0x00, 0x01, 0x80, 0x00, 0x00, 0x01, 0xC0, 0xC0, 0x00, 0x03, 0xC0, 0xE0, 0x00, 0x03, 0xC0, 0xF0, 0x00, 0x03, 0xC0, 0xF0, 0x00, 0x07, 0x80, 0x78, 0x00, 0x0D, 0xE0,
  0x38, 0x00, 0x0E, 0xF0, 0x3C, 0x00, 0x3D, 0x58, 0x1F, 0x00, 0x7E, 0xBC, 0x0F, 0xE0, 0xF5, 0x4E, 0x07, 0xFF, 0xF4, 0xAC, 0x03, 0xFF, 0xFA, 0xB6, 0x00, 0x7F, 0x9D, 0x4C, 0x00, 0x00, 0x0F, 0x5C,
  0x00, 0x00, 0x07, 0xBC, 0x00, 0x00, 0x03, 0xF8, 0x00, 0x00, 0x00, 0xD0
};

const unsigned char bouche3[] PROGMEM = { // 37 * 20
  0x7F, 0xFF, 0xFF, 0xFF, 0xF0, 0xFF, 0xFF, 0xFF, 0xFF, 0xF8, 0xFF, 0xFF,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 0xF0,
  0x7C, 0x00, 0x00, 0x03, 0xE0, 0x3C, 0x00, 0x00, 0x03, 0xE0, 0x3F, 0x00,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 0x00,
  0x00, 0xFF, 0xFF, 0xF0, 0x00, 0x00, 0x7F, 0xFF, 0xE0, 0x00, 0x00, 0x0F, 0xFF, 0xC0, 0x00, 0x00, 0x03, 0xFE, 0x00, 0x00
};

const unsigned char bouche4[] PROGMEM = { //19*27
  0x01, 0xF0, 0x00, 0x07, 0xFC, 0x00, 0x0F, 0xFE, 0x00, 0x1F, 0x1F, 0x00,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 0xE0,
  0xE0, 0x00, 0xE0, 0xE0, 0x00, 0xE0, 0xE0, 0x00, 0xE0, 0xE0, 0x00, 0xE0,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 0x00,
  0x0F, 0xFE, 0x00, 0x07, 0xFC, 0x00, 0x01, 0xF0, 0x00
};

const unsigned char bouche5[] PROGMEM = { // 30 * 13
  0xE0, 0x00, 0x00, 0x1C, 0xE0, 0x00, 0x00, 0x1C, 0xF0, 0x00, 0x00, 0x3C, 0x70, 0x00, 0x00, 0x38, 0x78, 0x00, 0x00, 0x78,
  0x3C, 0x00, 0x00, 0xF0, 0x1E, 0x00, 0x01, 0xE0, 0x0F, 0x00, 0x03, 0xC0, 0x07, 0xC0, 0x0F, 0x80, 0x03, 0xF8, 0x7F, 0x00,
  0x01, 0xFF, 0xFE, 0x00, 0x00, 0xFF, 0xF8, 0x00, 0x00, 0x1F, 0xE0, 0x00
};

const unsigned char bouche6[] PROGMEM = {// 30 * 13
  0x00, 0x1F, 0xE0, 0x00, 0x00, 0xFF, 0xF8, 0x00, 0x01, 0xFF, 0xFE, 0x00, 0x03, 0xF8, 0x7F, 0x00, 0x07, 0xC0, 0x0F, 0x80,
  0x0F, 0x00, 0x03, 0xC0, 0x1E, 0x00, 0x01, 0xE0, 0x3C, 0x00, 0x00, 0xF0, 0x78, 0x00, 0x00, 0x78, 0x70, 0x00, 0x00, 0x38, 0xF0, 0x00, 0x00, 0x3C,
  0xE0, 0x00, 0x00, 0x1C, 0xE0, 0x00, 0x00, 0x1C
};

const unsigned char tache[] PROGMEM = { //18 * 12
  0x10, 0x28, 0x00, 0x05, 0x01, 0x00, 0x10, 0x54, 0x00, 0x8A, 0x41, 0x00,
  0x42, 0x28, 0x00, 0x24, 0x85, 0x40, 0x88, 0x28, 0x00, 0x45, 0x0B, 0x00,
  0x21, 0x41, 0x00, 0x08, 0x90, 0x00, 0x02, 0x00, 0x00, 0x00, 0x00, 0x00
};

//================================================================
//  _____           _
// |  __ \         | |
// | |__) | __ ___ | |_ ___
// |  ___/ '__/ _ \| __/ _ \ 
// | |   | | | (_) | || (_) |
// |_|   |_|  \___/ \__\___/
//================================================================
int ReadBat(void);
float RealBat(void);
void choix_mode(void);
void print_time(void);
void choix_oui_non(void);
void musique(void);
void visage(void);
void mute_fonc(void);
void random_face_fonc(void);
void de_manu(void);
void menu_back(String nom, int correcteur);
void menu_back2(String nom, int correcteur);
void crono(void);
void Variable_EEPRROM_INIT(void);
void Print_info(void);
void Print_temp(void);
void choix_manu( unsigned int vmax);
void draw_face_1(unsigned char pos);
void draw_face_2(unsigned char pos);
void draw_face_3(unsigned char pos);
void draw_face_4(unsigned char pos);
void draw_face_5(unsigned char pos);
void draw_face_6(unsigned char pos);
void draw_face_7(unsigned char pos);
void draw_face_8(unsigned char pos);


bool sound = 0;
bool draw_menu = false;
bool draw_visage = false;
bool led_state = LOW;
bool lazer_state = LOW;
bool Random_face = 0;
unsigned char mode = 0;
unsigned long start = 0;

unsigned char number_oled = 0;

unsigned char V1 =0;
unsigned char V2 =100;
unsigned char V3 =200;

unsigned char reglage = 0;

#define MbrMoyenne 16
unsigned int TabBat[MbrMoyenne+1];
unsigned char lastBAT = 1200;

void IRAM_ATTR ISR() {
    digitalWrite(LED, LOW);  
    Serial.println("DODO");
    display.clearDisplay();
    digitalWrite(I2C_SDA,0);
    digitalWrite(I2C_SCL,0);
    esp_deep_sleep_start();
}

//=============SETUP=============
void setup() {
  //USB pour debug
  Serial.begin(115200);
  Serial.println("SETUP");



  //Description des pins
  pinMode(LED, OUTPUT);
  pinMode(MesBatEn, OUTPUT);
  
  //adc1_config_width(ADC_WIDTH_BIT_12);
  //adc1_config_channel_atten(ADC1_CHANNEL_4, ADC_ATTEN_DB_2_5);
  
  pinMode(charge, INPUT);
  pinMode(MesBat, INPUT);
  pinMode(PWR, INPUT_PULLDOWN);
  pinMode(BP1, INPUT_PULLDOWN);
  pinMode(BP2, INPUT_PULLDOWN);
  pinMode(BP3, INPUT_PULLDOWN);
  pinMode(I2C_SDA, OUTPUT);
  pinMode(I2C_SCL, OUTPUT);
  //ledcAttachPin(PIN_BUZZER, 0);

  //Def deepsleep
  esp_deep_sleep_enable_gpio_wakeup(BIT(GPIO_NUM_2),ESP_GPIO_WAKEUP_GPIO_HIGH);
  attachInterrupt(2, ISR, FALLING);

  for(int i = 0; i <= MbrMoyenne; i++){
    ReadBat();
  }
  Serial.print("BAT ");
  Serial.println(ReadBat());
  if(ReadBat() < 940 && !digitalRead(charge)){
    Serial.print("LOWBAT ");
    Serial.println(ReadBat());
    //esp_deep_sleep_start();
  }

  //EERRPOM
  EEPROM.begin(EEPROM_SIZE);
  Serial.print("mode1 ");
  Serial.println(mode);
  Variable_EEPRROM_INIT();              
  
  digitalWrite(LED, LOW); 

  //I2C
  Wire.begin(I2C_SDA, I2C_SCL);

  //STH30
  STH30.Begin();

  //BMP280
  bmp.begin(0x76);
  bmp.setSampling(Adafruit_BMP280::MODE_NORMAL,     /* Operating Mode. */
                  Adafruit_BMP280::SAMPLING_X2,     /* Temp. oversampling */
                  Adafruit_BMP280::SAMPLING_X16,    /* Pressure oversampling */
                  Adafruit_BMP280::FILTER_X16,      /* Filtering. */
                  Adafruit_BMP280::STANDBY_MS_500); /* Standby time. */

  //OLED
  display.begin(SSD1306_SWITCHCAPVCC, 0x3C);
  display.clearDisplay();
  display.setTextSize(1);      // Normal 1:1 pixel scale
  display.setTextColor(SSD1306_WHITE); // Draw white text
  display.setCursor(0, 0);     // Start at top-left corner
  display.println("j'ai perdu conscience!");
  display.display();
//  draw_face_5(0);
//  delay(1500);
//  draw_face_4(0);
//  delay(1500);
//  draw_face_3(0);
//  delay(1500);
//  display.clearDisplay();
//  display.display();
//  delay(2500);
  //RTC
  if(rtc.getYear() == 1970){
    rtc.setTime(0, 0, 0, 1, 1, 2022);  // 17th Jan 2021 15:24:30
    reglage = 1;
    print_time(); 
  }
  Serial.println("setup complete  !");
  
  start = millis();
}


void loop() {
  display.clearDisplay();

  //Détection boutons
  if (digitalRead(BP1) == HIGH) { // BOUTON 1
    while (digitalRead(BP1) == HIGH) draw_menu = 1;
    //if (sound == true)tone(5, 500, 100);
    menu();
  }

  if (digitalRead(BP2) == HIGH) { // BOUTON 2
    //choix_oui_non();
    while (digitalRead(BP2) == HIGH) start = millis();
  }

  if (digitalRead(BP3) == HIGH) { // BOUTON 3
    while (digitalRead(BP3) == HIGH) print_time();

  }

 if (mode == 0) {
    switch (number_oled) {
      case 0:
        if     (millis() - start < 300) draw_face_1(0);
        else if (millis() - start < 600) draw_face_1(1);
        else    start = millis();
        break;
      case 1:
        if     (millis() - start < 300) draw_face_2(0);
        else if (millis() - start < 600) draw_face_2(1);
        else    start = millis();
        break;
      case 2:
        if     (millis() - start < 300) draw_face_3(0);
        else if (millis() - start < 600) draw_face_3(1);
        else    start = millis();
        break;
      default:
        number_oled = 0;
        break;
    }
  }
  else if (mode == 1) {
    print_time();
    delay(100);
  }
  delay(200);
}
